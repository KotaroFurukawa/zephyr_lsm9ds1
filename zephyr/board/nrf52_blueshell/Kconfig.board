## zephyr/board/nrf52_blueshell/Kconfig.board
```kconfig
# Kconfig - nRF52 BLENANO 2 board configuration
#
# Copyright (c) 2016 Linaro Limited.
#
# SPDX-License-Identifier: Apache-2.0


config BOARD_NRF52_BLUESHELL
	bool "nRF52 BLUESHELL"
	depends on SOC_NRF52832_QFAA

if BOARD_NRF52_BLUESHELL

config BOARD_NRF52_BLUESHELL_RESET
	bool "Enable GPIO reset line"
        default y
	help
	 nRF52832 reset pin

if BOARD_NRF52_BLUESHELL_RESET

comment "nRF52 pins"

config BOARD_NRF52_BLUESHELL_RESET_P0_21
	bool "P0.21"
        default y
	help
	 Pin P0.21 on nRF52832.


endif # BOARD_NRF52_BLUESHELL_RESET


endif # BOARD_NRF52_BLUESHELL
```

## zephyr/board/nrf52_blueshell/nrf52_blueshell_defconfig
```kconfig
# SPDX-License-Identifier: Apache-2.0

CONFIG_ARM=y
CONFIG_SOC_FAMILY_NRF=y
CONFIG_SOC_SERIES_NRF52X=y
CONFIG_SOC_NRF52832_QFAA=y
CONFIG_BOARD_NRF52_BLUESHELL=y

# Enable MPU
CONFIG_ARM_MPU=y

# enable GPIO
CONFIG_GPIO=y

# disable console
CONFIG_CONSOLE=n
CONFIG_UART_CONSOLE=n
CONFIG_STDOUT_CONSOLE=n

# NFC pin use GPIO 
CONFIG_NFCT_PINS_AS_GPIOS=y

# bluetooth
CONFIG_BT=y
CONFIG_BT_CTLR=y
```
